## Documentation/devicetree/bindings/display/xlnx/xlnx,v-tpg.yaml
```yaml
# SPDX-License-Identifier: (GPL-2.0-only OR BSD-2-Clause)
%YAML 1.2
---
$id: http://devicetree.org/schemas/display/xlnx/xlnx,v-tpg.yaml#
$schema: http://devicetree.org/meta-schemas/core.yaml#

title: Xilinx Video Test Pattern Generator (TPG)

description:
  AMD/Xilinx Video Test Pattern Generator IP is a soft IP designed to
  generate test video signal in AXI4-Stream Video format.
  https://docs.xilinx.com/r/en-US/pg103-v-tpg

maintainers:
  - Anatoliy Klymenko <anatoliy.klymenko@amd.com>

properties:
  compatible:
    description:
      TPG versions backward-compatible with previous versions should list all
      compatible versions in the newer to older order.
    enum: ["xlnx,v-tpg-8.0", "xlnx,v-tpg-8.2"]

  reg:
    maxItems: 1

  interrupts:
    maxItems: 1

  bus-format:
    description:
      Output media bus format, one of MEDIA_BUS_FMT_* from
      include/dt-bindings/media/media-bus-format.h
    $ref: /schemas/types.yaml#/definitions/uint32

  xlnx,bridge:
    description:
      Reference to Video Timing Controller phandle
    $ref: /schemas/types.yaml#/definitions/phandle

  ports:
    $ref: /schemas/graph.yaml#/properties/ports
    description:
      Connections from and to external components in the video pipeline.

    properties:
      port@0:
        $ref: /schemas/graph.yaml#/properties/port
        description:
          Sink port connected to downstream video IP.

      port@1:
        $ref: /schemas/graph.yaml#/properties/port
        description:
          Source port to connect to optional video signal source.

    required:
      - port@0

required:
  - compatible
  - reg
  - interrupts
  - bus-format
  - xlnx,bridge
  - ports

additionalProperties: false

examples:
  - |
    #include <dt-bindings/media/media-bus-format.h>

    tpg_0: tpg@40050000 {
      compatible = "xlnx,v-tpg-8.0";
      reg = <0x40050000 0x10000>;
      interrupts = <0 89 4>;
      xlnx,bridge = <&vtc_3>;
      bus-format = <MEDIA_BUS_FMT_UYVY8_1X16>;
      ports {
        #address-cells = <1>;
        #size-cells = <0>;
        port@0 {
          reg = <0>;
          tpg_out: endpoint {
            remote-endpoint = <&dp_encoder>;
          };
        };
      };
    };

...
```

## Documentation/devicetree/bindings/display/xlnx/xlnx,vtc.yaml
```yaml
# SPDX-License-Identifier: (GPL-2.0-only OR BSD-2-Clause)
%YAML 1.2
---
$id: http://devicetree.org/schemas/display/xlnx/xlnx,vtc.yaml#
$schema: http://devicetree.org/meta-schemas/core.yaml#

title: Device-Tree for Xilinx Video Timing Controller(VTC)

description:
  Xilinx VTC is a general purpose video timing generator and detector.
  The input side of this core automatically detects horizontal and
  vertical synchronization, pulses, polarity, blanking timing and active pixels.
  While on the output, it generates the horizontal and vertical blanking and
  synchronization pulses used with a standard video system including support
  for programmable pulse polarity.

  The core is commonly used with Video in to AXI4-Stream core to detect the
  format and timing of incoming video data or with AXI4-Stream to Video out core
  to generate outgoing video timing for downstream sinks like a video monitor.

  For details please refer to
  https://docs.xilinx.com/r/en-US/pg016_v_tc

maintainers:
  - Sagar Vishal <sagar.vishal.com>

properties:
  compatible:
    const: "xlnx,bridge-v-tc-6.1"

  reg:
    maxItems: 1

  xlnx,pixels-per-clock:
    description: Pixels per clock of the stream.
    $ref: /schemas/types.yaml#/definitions/uint32
    enum: [1, 2, 4]

  clocks:
    minItems: 2

  clock-names:
    items:
      - const: clk
      - const: s_axi_aclk

required:
  - compatible
  - reg
  - xlnx,pixels-per-clock
  - clocks
  - clock-names

additionalProperties: false

examples:
  - |
    v_tc_0: v_tc@80010000 {
      clock-names = "clk", "s_axi_aclk";
      clocks = <&clk_wiz_0>, <&misc_clk_0>;
      compatible = "xlnx,bridge-v-tc-6.1";
      xlnx,pixels-per-clock = <1>;
      reg = <0x80010000 0x10000>;
    };

...
```

## drivers/gpu/drm/xlnx/Kconfig
```kconfig
config DRM_ZYNQMP_DPSUB
	tristate "ZynqMP DisplayPort Controller Driver"
	depends on ARCH_ZYNQMP || COMPILE_TEST
	depends on COMMON_CLK && DRM && OF
	depends on DMADEVICES
	depends on PHY_XILINX_ZYNQMP
	depends on XILINX_ZYNQMP_DPDMA
	select DMA_ENGINE
	select DRM_DISPLAY_DP_HELPER
	select DRM_DISPLAY_HELPER
	select DRM_GEM_DMA_HELPER
	select DRM_KMS_HELPER
	select GENERIC_PHY
	help
	  This is a DRM/KMS driver for ZynqMP DisplayPort controller. Choose
	  this option if you have a Xilinx ZynqMP SoC with DisplayPort
	  subsystem.

config DRM_XLNX_BRIDGE_VTC
	bool "Xilinx DRM VTC Driver"
	depends on OF
	help
	  DRM brige driver for Xilinx Video Timing Controller. Choose
	  this option to make VTC a part of the CRTC in display pipeline.
	  Currently the support is added to the Xilinx Video Mixer and
	  Xilinx PL display CRTC drivers. This driver provides ability
	  to generate timings through the bridge layer.

config DRM_XLNX_TPG
	bool "Xilinx DRM TPG Driver"
	depends on DRM && OF
	select DRM_XLNX_BRIDGE_VTC
	select VIDEOMODE_HELPERS
	help
	  CRTC driver based on AMD/Xilinx Test Pattern Generator IP. Choose
	  this driver to enable Test Pattern Generator CRTC. This driver
	  implements simplistic CRTC with the single plane and is perfect for
	  testing PL to PS and PL to PL display output pipelines.
```
